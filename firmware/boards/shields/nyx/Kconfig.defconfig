## firmware/boards/shields/nyx/Kconfig.defconfig
```kconfig
# -*- mode: makefile; -*-

if SHIELD_NYX_LEFT

config ZMK_KEYBOARD_NAME
	default "Nyx"

config ZMK_SPLIT_BLE_ROLE_CENTRAL
	default y

endif

if SHIELD_NYX_LEFT || SHIELD_NYX_RIGHT

config ZMK_SPLIT
	default y

endif
```

## firmware/boards/shields/nyx/Kconfig.shield
```kconfig
# -*- mode: makefile; -*-

config SHIELD_NYX_LEFT
    def_bool $(shields_list_contains,nyx_left)

config SHIELD_NYX_RIGHT
    def_bool $(shields_list_contains,nyx_right)
```
