/*
 * Copyright (c) 2020 Tad Fisher
 *
 * SPDX-License-Identifier: MIT
 */

#include "nyx.dtsi"

&default_transform {
    col-offset = <7>;
};

&kscan0 {
    col-gpios
        = <&pro_micro_d 1 GPIO_ACTIVE_HIGH> // col0
        , <&pro_micro_d 0 GPIO_ACTIVE_HIGH> // col1
        , <&pro_micro_d 2 GPIO_ACTIVE_HIGH> // col2
        , <&pro_micro_d 3 GPIO_ACTIVE_HIGH> // col3
        , <&pro_micro_d 4 GPIO_ACTIVE_HIGH> // col4
        , <&pro_micro_d 5 GPIO_ACTIVE_HIGH> // col5
        , <&pro_micro_d 7 GPIO_ACTIVE_HIGH> // col6
        ;
};
